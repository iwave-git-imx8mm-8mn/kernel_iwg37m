## drivers/input/touchscreen/cst148/Kconfig
```kconfig
#
# Touchscreen driver configuration
#

config HYN_CST3XX_TOUCHSCREEN_SUPPORT
	bool "hyn_cst3xx/cst1XX for touchscreen"
	depends on TOUCHSCREEN_CST148
	default n
	help
	Say Y here if you have hyn_cst148 touch panel GTP_POWER_CTRL_SLEEP.

	If unsure, say N.

	To compile this dirver as a module, choose M here: the
	module will be called.
```
